## bootloader/bootloader_qemu.its
```
/dts-v1/;
/ {
    description = "Bootloader FIT image (QEMU)";
    #address-cells = <2>;
    images {
        kernel {
            description = "Bootloader";
            data = /incbin/("bootloader");
            type = "kernel";
            arch = "riscv";
            os = "linux";
            compression = "none";
            load = <0x0 0x80200000>;
            entry = <0x0 0x80200000>;
        };
    };
    configurations {
        default = "config-1";
        config-1 {
            description = "Bootloader";
            kernel = "kernel";
        };
    };
};
```
